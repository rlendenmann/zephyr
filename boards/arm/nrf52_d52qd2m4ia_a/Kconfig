## boards/arm/nrf52_d52qd2m4ia_a/Kconfig
```kconfig
# Kconfig - nRF52 Dynastream D52QD2M4IA-A modulue board configuration
#
# Copyright (c) 2017 Intel Semiconductor
#
# SPDX-License-Identifier: Apache-2.0

if BOARD_NRF52_D52QD2M4IA_A

config  GPIO_AS_PINRESET
	bool "GPIO as pin reset"
	default y

endif # BOARD_NRF52_D52QD2M4IA_A
```

## boards/arm/nrf52_d52qd2m4ia_a/Kconfig.board
```kconfig
# Kconfig - nRF52 Dynastream D52QD2M4IA-A modulue board configuration
#
# Copyright (c) 2017 Intel Semiconductor
#
# SPDX-License-Identifier: Apache-2.0

config  BOARD_NRF52_D52QD2M4IA_A
	bool "nRF52 Dynastream D52QD2M4IA-A"
	depends on SOC_NRF52832_QFAA
```

## boards/arm/nrf52_d52qd2m4ia_a/Kconfig.defconfig
```kconfig
# Kconfig - nRF52 Dynastream D52QD2M4IA-A modulue board configuration
#
# Copyright (c) 2017 Intel Semiconductor
#
# SPDX-License-Identifier: Apache-2.0

if BOARD_NRF52_D52QD2M4IA_A

config BOARD
	default nrf52_d52qd2m4ia_a

if GPIO_NRF5

config GPIO_NRF5_P0
	default y

endif # GPIO_NRF5

if UART_NRF5

config UART_NRF5_GPIO_TX_PIN
	default 6

config UART_NRF5_GPIO_RX_PIN
	default 8

config UART_NRF5_GPIO_RTS_PIN
	default 5

config UART_NRF5_GPIO_CTS_PIN
	default 7

endif # UART_NRF5

endif # BOARD_NRF52_D52QD2M4IA_A
```

## boards/arm/nrf52_d52qd2m4ia_a/nrf52_d52qd2m4ia_a_defconfig
```kconfig
CONFIG_ARM=y
CONFIG_SOC_FAMILY_NRF5=y
CONFIG_SOC_SERIES_NRF52X=y
CONFIG_SOC_NRF52832_QFAA=y
CONFIG_BOARD_NRF52_D52QD2M4IA_A=y

# enable uart driver
CONFIG_SERIAL=y
CONFIG_UART_NRF5=y

# enable console
CONFIG_CONSOLE=y
CONFIG_UART_CONSOLE=y

# additional board options
CONFIG_GPIO_AS_PINRESET=y

# bluetooth
CONFIG_BLUETOOTH=y
CONFIG_BLUETOOTH_CONTROLLER=y

# nrf52 spim 0 support
CONFIG_SPI=y
CONFIG_SPI_CS_GPIO=y
CONFIG_SPI_0=y
CONFIG_SPI_0_IRQ_PRI=1
CONFIG_SPI_0_CS_GPIO_PIN=27

CONFIG_SPI_NRF5=y
CONFIG_SPIM0_NRF52=y
CONFIG_SPIM0_NRF52_GPIO_SCK_PIN=30
CONFIG_SPIM0_NRF52_GPIO_MOSI_PIN=29
CONFIG_SPIM0_NRF52_GPIO_MISO_PIN=28
CONFIG_SPIM0_NRF52_GPIO_SS_PIN_0=27

# accelerometer lis2dh support
CONFIG_SENSOR=y
CONFIG_LIS2DH=y
CONFIG_LIS2DH_BUS_SPI=y
```
